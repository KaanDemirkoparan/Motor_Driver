/**
 * @cliArgs --board "/boards/LAUNCHXL_F28379D" --device "F2837xD" --part "F2837xD_337ZWT" --package "F2837xD_337ZWT" --context "CPU1" --product "C2000WARE@5.04.00.00"
 * @versions {"tool":"1.22.0+3893"}
 */

/**
 * Import the modules used in this configuration.
 */
const adc   = scripting.addModule("/driverlib/adc.js", {}, false);
const adc1  = adc.addInstance();
const epwm  = scripting.addModule("/driverlib/epwm.js", {}, false);
const epwm1 = epwm.addInstance();

/**
 * Write custom configuration values to the imported modules.
 */
adc1.$name                       = "myADC0";
adc1.adcClockPrescaler           = "ADC_CLK_DIV_4_0";
adc1.enabledSOCs                 = ["ADC_SOC_NUMBER0","ADC_SOC_NUMBER1","ADC_SOC_NUMBER2","ADC_SOC_NUMBER3","ADC_SOC_NUMBER4","ADC_SOC_NUMBER5"];
adc1.soc0UseSampleTimeCalculator = true;
adc1.soc0InputCapacitance        = 220;
adc1.soc0InputResistance         = 500;
adc1.soc0UseCalculatedSampleTime = true;
adc1.soc1SampleWindow            = 162;
adc1.soc2SampleWindow            = 162;
adc1.soc3SampleWindow            = 162;
adc1.soc4SampleWindow            = 162;
adc1.soc5SampleWindow            = 162;
adc1.soc0Channel                 = "ADC_CH_ADCIN3";
adc1.soc0Trigger                 = "ADC_TRIGGER_EPWM4_SOCA";
adc1.soc1Trigger                 = "ADC_TRIGGER_EPWM4_SOCA";
adc1.soc2Trigger                 = "ADC_TRIGGER_EPWM4_SOCA";
adc1.interruptPulseMode          = "ADC_PULSE_END_OF_CONV";
adc1.enabledInts                 = ["ADC_INT_NUMBER1"];
adc1.enableInterrupt1            = true;

epwm1.$name                                                    = "myEPWM4";
epwm1.useCase                                                  = "CUSTOM";
epwm1.useInterfacePins                                         = ["EPWM#B"];
epwm1.$hardware                                                = system.deviceData.board.components.BP_SITE_2.subComponents.PWM_LOC1;
epwm1.epwmTimebase_hsClockDiv                                  = "EPWM_HSCLOCK_DIVIDER_1";
epwm1.epwmTimebase_counterMode                                 = "EPWM_COUNTER_MODE_UP";
epwm1.epwmCounterCompare_cmpB                                  = 100;
epwm1.epwmActionQualifier_EPWM_AQ_OUTPUT_B_shadowMode          = true;
epwm1.epwmActionQualifier_EPWM_AQ_OUTPUT_B_ON_TIMEBASE_ZERO    = "EPWM_AQ_OUTPUT_HIGH";
epwm1.epwmActionQualifier_EPWM_AQ_OUTPUT_B_ON_TIMEBASE_UP_CMPB = "EPWM_AQ_OUTPUT_LOW";
epwm1.epwmTimebase_period                                      = 200;

/**
 * Pinmux solution for unlocked pins/peripherals. This ensures that minor changes to the automatic solver in a future
 * version of the tool will not impact the pinmux you originally saw.  These lines can be completely deleted in order to
 * re-solve from scratch.
 */
epwm1.epwm.$suggestSolution           = "EPWM4";
epwm1.epwm.epwm_bPin.$suggestSolution = "boosterpack2.79";
